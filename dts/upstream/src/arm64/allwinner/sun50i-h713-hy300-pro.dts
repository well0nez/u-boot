// SPDX-License-Identifier: (GPL-2.0+ OR MIT)
/*
 * "HY300 Pro" projector, reported in issue #1 of
 * well0nez/allwinner-h713-linux by its owner. Nobody here has held one.
 *
 * Like the HY310's tree, this is an include of the bench board's rather than a
 * copy, for the same reason: a board should boot a device tree named after
 * itself, so that a boot log says which board it is running on instead of
 * naming one nobody has built for. The DRAM clock that distinguishes this
 * board (636 MHz) lives in configs/hy300_pro_defconfig, not here.
 *
 * What is *not* claimed by this file: the panel. It declares project id 0x34,
 * and that is all that is known about its display -- resolution, timings and
 * port count have never been read off it. No node here describes a panel in
 * any case; the display coprocessor drives it from its own tables.
 *
 * Nothing else about this board has been measured as different from the bench
 * board's tree, so nothing else is overridden. When something is measured, it
 * belongs here.
 */

#include "sun50i-h713-hy200-qz713df-a1.dts"

/ {
	model = "MagCubic HY300 Pro";
	compatible = "magcubic,hy300-pro", "allwinner,sun50i-h713";
};
